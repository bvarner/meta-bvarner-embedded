## conf/layer.conf
```bitbake
# We have a conf and classes directory, append to BBPATH
BBPATH .= ":${LAYERDIR}"

# We have a recipes directory containing .bb and .bbappend files, add to BBFILES
BBFILES += "${LAYERDIR}/recipes*/*/*.bb \
            ${LAYERDIR}/recipes*/*/*.bbappend \
            ${LAYERDIR}/images/*.bb \
            ${LAYERDIR}/images/*.bbappend"

BBFILE_COLLECTIONS += "meta-bvarner-embedded"
BBFILE_PATTERN_meta-bvarner-embedded := "^${LAYERDIR}/"
BBFILE_PRIORITY_meta-bvarner-embedded = "8"

LAYERSERIES_COMPAT_meta-bvarner-embedded  = "dunfell zeus"
```

## projects/garage-door-opener/build/conf/bblayers.conf
```bitbake
# POKY_BBLAYERS_CONF_VERSION is increased each time build/conf/bblayers.conf
# changes incompatibly
POKY_BBLAYERS_CONF_VERSION = "2"

BBPATH = "${TOPDIR}"
BBFILES ?= ""

BBLAYERS ?= " \
  %YOCTO_DIR%/poky/meta \
  %YOCTO_DIR%/poky/meta-poky \
  %YOCTO_DIR%/poky/meta-yocto-bsp \
  %YOCTO_DIR%/poky/meta-openembedded/meta-oe \
  %YOCTO_DIR%/poky/meta-openembedded/meta-python \
  %YOCTO_DIR%/poky/meta-raspberrypi \
  %YOCTO_DIR%/poky/meta-bvarner-embedded \
  "
```

## projects/garage-door-opener/build/conf/local.conf
```bitbake
# Local Configuration for building garage-door-opener-images
# Using Yocto Project 2.4 Poky distribution [rocko] branch
CONF_VERSION = "1"

# Host Machine
# ------------

# i686 or x86_64
SDKMACHINE = "x86_64"

# Target Machine
# --------------
MACHINE = "raspberrypi0-wifi"

# We don't need much GPU for the garage door opener.
GPU_MEM = "16"

# We don't need any overhead for this project...
IMAGE_OVERHEAD_FACTOR = "1.05"
IMAGE_FSTYPES = "tar.xz rpi-sdimg"
SDIMG_ROOTFS_TYPE = "ext4"

# sets our host name
hostname_pn-base-files = "garage-door"

# Distro Setup
# ------------
DISTRO = "poky"

DISTRO_FEATURES = "systemd usbhost wifi zeroconf"
DISTRO_FEATURES_BACKFILL_CONSIDERED += "sysvinit"

VIRTUAL-RUNTIME_init_manager = "systemd"
VIRTUAL-RUNTIME_initscripts = ""

PACKAGE_CLASSES = "package_ipk"

LICENSE_FLAGS_WHITELIST = "commercial"

USER_CLASSES = "image-mklibs image-prelink"

PATCHRESOLVE = "noop"


# Build Behavior
# --------------
# Download Directory (can be shared amongst different local.conf setups)
DL_DIR = "%SHARED_DIR%/sources"

# Working Directory (can be shared amongst different local.conf setups)
TMPDIR = "%SHARED_DIR%/tmp"

# Shared State cache (Not sure I'd share this one.)
SSTATE_DIR = "%PROJECT_DIR%/sstate-cache"

RM_OLD_IMAGE = "1"
INHERIT += "rm_work"
```

## wic/sdimage-raspberrypi-persistentvar.wks
```
# short-description: Create Raspberry Pi SD card image with a large /var partition
# long-description: Creates a partitioned SD card image for use with
# Raspberry Pi. Boot files are located in the first vfat partition, a large /var partition exists.

# 16gb sdhc card: - 2% free space (for wear leveling) - boot part - rootfs size - swap = /var size.
# 16384 - 3276 - 20 - rootfssize - 2048 = /var

part /boot --source bootimg-partition --ondisk mmcblk0 --fstype=vfat --label boot --active --align 4096 --size 20
part / --source rootfs --ondisk mmcblk0 --fstype=ext4 --label root --align 4096
part swap --ondisk mmcblk0 --fstype=swap --label swap --align 4096 --size 2048
part /var --ondisk mmcblk0 --fstype=ext4 --label var --align 4096 --size 10240 --fsoptions=noatime
```
